#include "kbName.dtsi" // The shared dtsi file is included in the overlay

// Label of the kscan node in the dtsi
&kscan {
	//col-gpios defined per half
	col-gpios
	    = <&pro_micro 10 GPIO_ACTIVE_HIGH>
	    , <&pro_micro 16 GPIO_ACTIVE_HIGH>
	    , <&pro_micro 14 GPIO_ACTIVE_HIGH>
	    , <&pro_micro 15 GPIO_ACTIVE_HIGH>
	    ;
};

&default_transform { // Offset of 4 because the left side has 4 columns
    col-offset = <4>;
};

