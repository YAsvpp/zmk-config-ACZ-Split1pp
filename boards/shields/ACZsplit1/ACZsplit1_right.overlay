#include "ACZsplit1.dtsi" // The shared dtsi file is included in the overlay

// Label of the kscan node in the dtsi
&kscan {
	//col-gpios defined per half
	col-gpios = <&pro_micro 19 GPIO_ACTIVE_HIGH>,	
				<&pro_micro 1 GPIO_ACTIVE_HIGH>,
				<&pro_micro 7 GPIO_ACTIVE_HIGH>,
				<&pro_micro 5 GPIO_ACTIVE_HIGH>,
				<&pro_micro 4 GPIO_ACTIVE_HIGH>,
				<&pro_micro 3 GPIO_ACTIVE_HIGH>,
				<&pro_micro 2 GPIO_ACTIVE_HIGH>;
};

&default_transform { // Offset of 7 because the left side has 7 columns
    col-offset = <7>;
};

